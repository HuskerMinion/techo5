## tools/linux/athena/kernel/src/camera/isp/Kconfig
```kconfig
# SPDX-License-Identifier: GPL-2.0-only

config MTK_CAMSV
	tristate "MediaTek ISP3.0 CAMSV driver"
	depends on ARCH_MEDIATEK || COMPILE_TEST
	depends on OF
	depends on PM
	select MEDIA_CONTROLLER
	select MTK_SENINF30
	select VIDEO_V4L2_SUBDEV_API
	select VIDEOBUF2_DMA_CONTIG
	default n
	help
	  This driver provides a path to bypass the SoC ISP so that
	  image data come from the SENINF can go directly into memory
	  without any image processing.

	  To compile this driver as a module, choose M here: the
	  module will be called mtk-camsv.

config MTK_SENINF30
	tristate "MediaTek ISP3.0 SENINF driver"
	depends on ARCH_MEDIATEK || COMPILE_TEST
	depends on OF
	select MEDIA_CONTROLLER
	select PHY_MTK_MIPI_CSI_0_5
	select V4L2_FWNODE
	select VIDEO_V4L2_SUBDEV_API
	default n
	help
	  This driver provides a MIPI CSI-2 receiver interface to connect
	  an external camera module with MediaTek ISP3.0. It is able to handle
	  multiple cameras at the same time.

	  To compile this driver as a module, choose M here: the
	  module will be called mtk-seninf.
```
